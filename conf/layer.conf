## conf/layer.conf
```bitbake
# We have a conf and classes directory, add to BBPATH
BBPATH .= ":${LAYERDIR}"

# We have recipes-* directories, add to BBFILES
BBFILES += "${LAYERDIR}/recipes-*/*/*.bb \
            ${LAYERDIR}/recipes-*/*/*.bbappend"

BBFILE_COLLECTIONS += "meta-adcsamplebeat"
BBFILE_PATTERN_meta-adcsamplebeat = "^${LAYERDIR}/"
BBFILE_PRIORITY_meta-adcsamplebeat = "6"

LAYERDEPENDS_meta-adcsamplebeat = "core"
LAYERSERIES_COMPAT_meta-adcsamplebeat = "warrior zeus dunfell"
```
